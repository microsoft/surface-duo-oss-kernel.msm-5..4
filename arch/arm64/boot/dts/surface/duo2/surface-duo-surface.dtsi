/*
 * Copyright (c) 2020 Microsoft Corporation
 *
 * This program is free software; you can redistribute it and/or modify it
 * under the terms of the GNU General Public License version 2 as published by
 * the Free Software Foundation.
 */

&soc {
    surface_util: surface_util {
            compatible = "surface,surface_util";
            module-names = "fuse_check", "mcfg_check","display_state","ms_pen_charger";
            display_c3 = <&tlmm 67 0x00>;
            display_r2 = <&tlmm 47 0x00>;
            ms_pen_charging_gpio = <&tlmm 39 0x00>;
    };

    oem_smem: oem_smem@0xE3400000 {
	    compatible = "surface,oem-smem";
	    reg = <0xE3400000 0x1000>;
	};
};
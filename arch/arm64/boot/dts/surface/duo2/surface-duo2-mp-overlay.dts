/*
 * Copyright (c) 2020 Microsoft Corporation
 *
 * This program is free software; you can redistribute it and/or modify it
 * under the terms of the GNU General Public License version 2 as published by
 * the Free Software Foundation.
 */

/dts-v1/;
/plugin/;

#include "surface-duo2-mp.dtsi"

/ {
	model = "Surface Duo2 MP";
	compatible = "qcom,lahaina-mtp", "qcom,lahaina";
	qcom,board-id = <0x10008 12>;
	qcom,msm-id = <415 0x10000>;
};

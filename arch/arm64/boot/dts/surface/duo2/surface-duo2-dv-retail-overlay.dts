/*
 * Copyright (c) 2020 Microsoft Corporation
 *
 * This program is free software; you can redistribute it and/or modify it
 * under the terms of the GNU General Public License version 2 as published by
 * the Free Software Foundation.
 */

/dts-v1/;
/plugin/;

#include "surface-duo2-dv-retail.dtsi"

/ {
	model = "Surface Duo2 DV_Retail";
	compatible = "qcom,lahaina-mtp", "qcom,lahaina";
	qcom,board-id = <0x10008 10>;
	qcom,msm-id = <415 0x10000>;
};
